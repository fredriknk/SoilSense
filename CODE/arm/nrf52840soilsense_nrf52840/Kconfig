## CODE/arm/nrf52840soilsense_nrf52840/Kconfig
```kconfig
# nrf52840soilsense_nrf52840 board configuration

# Copyright (c) 2016 Nordic Semiconductor ASA
# SPDX-License-Identifier: Apache-2.0

if BOARD_nrf52840soilsense_nrf52840

config BOARD_ENABLE_DCDC
	bool "DCDC mode"
	select SOC_DCDC_NRF52X
	default n

config BOARD_ENABLE_DCDC_HV
	bool "High Voltage DCDC converter"
	select SOC_DCDC_NRF52X_HV
	default n

endif # BOARD_nrf52840soilsense_nrf52840
```

## CODE/arm/nrf52840soilsense_nrf52840/Kconfig.board
```kconfig
# nrf52840soilsense_nrf52840 board configuration

# Copyright (c) 2016 Nordic Semiconductor ASA
# SPDX-License-Identifier: Apache-2.0

config BOARD_nrf52840soilsense_nrf52840
	bool "nrf52840soilsense_nrf52840"
	depends on SOC_NRF52840_QIAA
```

## CODE/arm/nrf52840soilsense_nrf52840/Kconfig.defconfig
```kconfig
# nrf52840soilsense_nrf52840 board configuration

# Copyright (c) 2016 Nordic Semiconductor ASA
# SPDX-License-Identifier: Apache-2.0

if BOARD_nrf52840soilsense_nrf52840

config BOARD
	default "nrf52840soilsense_nrf52840"

config BT_CTLR
	default BT

endif # BOARD_nrf52840soilsense_nrf52840
```
